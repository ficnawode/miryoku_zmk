#include "skeletyl.dtsi"

&default_transform {
    col-offset = <5>;
};

&kscan0 {
    wakeup-source;
    diode-direction = "col2row";
    row-gpios
        = <&gpio1 11 (GPIO_ACTIVE_HIGH | GPIO_PULL_DOWN)> 
        , <&gpio0 10 (GPIO_ACTIVE_HIGH | GPIO_PULL_DOWN)> 
        , <&gpio0 9 (GPIO_ACTIVE_HIGH | GPIO_PULL_DOWN)> 
        , <&gpio1 6 (GPIO_ACTIVE_HIGH | GPIO_PULL_DOWN)> 
        ;
    
    col-gpios
        = <&gpio0 31 GPIO_ACTIVE_HIGH> // 0 
        , <&gpio0 29 GPIO_ACTIVE_HIGH> // 1 
        , <&gpio0 2 GPIO_ACTIVE_HIGH> // 2 
        , <&gpio1 15 GPIO_ACTIVE_HIGH> // 3 
        , <&gpio1 13 GPIO_ACTIVE_HIGH>// 4
        ;
};
