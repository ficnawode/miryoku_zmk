## config/boards/shields/skeletyl/Kconfig.defconfig
```kconfig
if SHIELD_SKELETYL_LEFT
config ZMK_KEYBOARD_NAME
    default "Skeletyl Left"
endif

if SHIELD_SKELETYL_RIGHT
config ZMK_KEYBOARD_NAME
    default "Skeletyl Right"
endif

if SHIELD_SKELETYL_DONGLE
config ZMK_KEYBOARD_NAME
    default "Skeletyl Dongle"
endif
```
